#include <behaviors.dtsi>
#include <dt-bindings/zmk/keys.h>
#include <dt-bindings/zmk/bt.h>
#include <dt-bindings/zmk/ext_power.h>
#include <dt-bindings/zmk/outputs.h>
#include <dt-bindings/zmk/rgb.h>

#define HOST_OS 2 // = macOS
#include "zmk-helpers/helper.h" // HOST_OS must be defined before including it

#include "glove80_default_behaviors.dtsi"
#include "glove80_key_positions.h"


/* Layers */

#define DEFAULT 0
#define LOWER 1
#define MAGIC 2


/* Timings */

#define QUICK_TAP_MS 175

#define COMBO_TERM_FAST 18
#define COMBO_TERM_SLOW 30

#define COMBO_IDLE_FAST 150
#define COMBO_IDLE_SLOW 50

/* Reconfigurations */

&sk { // Sticky Key
	release-after-ms = <900>; // Release after 0.9s
	quick-release;            // No double capitalization when rolling keys
};

&sl { // Sticky Layer
	release-after-ms = <1000>; // Default: 1000
	ignore-modifiers;          // Allow chording sticky mods & layers
};

&lt { // Layer-Tap
	flavor = "balanced";
	tapping-term-ms = <200>;
	quick-tap-ms = <QUICK_TAP_MS>;
};


/* Homerow Mods */

#define MAKE_HRM(NAME, HOLD, TAP, TRIGGER_POS) \
    ZMK_HOLD_TAP(NAME, \
        flavor = "balanced"; \
        tapping-term-ms = <280>; \
        quick-tap-ms = <QUICK_TAP_MS>; \
        require-prior-idle-ms = <150>; \
        bindings = <HOLD>, <TAP>; \
        hold-trigger-key-positions = <TRIGGER_POS>; \
        hold-trigger-on-release; \
    )
MAKE_HRM(hml, &kp, &kp, KEYS_R THUMBS)
MAKE_HRM(hmr, &kp, &kp, KEYS_L THUMBS)
